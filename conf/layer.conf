## conf/layer.conf
```bitbake
# We have a conf and classes directory, add to BBPATH
BBPATH .= ":${LAYERDIR}"

# We have recipes-* directories, add to BBFILES
BBFILES += "${LAYERDIR}/recipes-*/*/*.bb \
            ${LAYERDIR}/recipes-*/*/*.bbappend"

BBFILE_COLLECTIONS += "meta-continental"
BBFILE_PATTERN_meta-continental = "^${LAYERDIR}/"
BBFILE_PRIORITY_meta-continental = "6"

LAYERDEPENDS_meta-continental = "core"
LAYERSERIES_COMPAT_meta-continental = "dunfell"
```
